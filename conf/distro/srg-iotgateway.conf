## conf/distro/srg-iotgateway.conf
```bitbake
# SRG IoT Gateway for Wayland with X11

include conf/distro/include/fsl-imx-base.inc
include conf/distro/include/fsl-imx-preferred-env.inc

DISTRO = "srg-iotgateway"

# Remove conflicting backends
DISTRO_FEATURES_remove = "directfb "
DISTRO_FEATURES_append = "x11 wayland pam systemd"

DISTRO = "srg-iotgateway"
DISTRO_NAME = "SRG IoT Gateway Distro"
DISTRO_VERSION = "5.10-gatesgarth"
```

## conf/layer.conf
```bitbake
#
# SRG-IM8P BSP
#
# Copyright (c) Sparktech/UWINGS, 2021
#
# Authors:
#  KunYi Chen <kunyi.chen@gmail.com>
#
# SPDX-License-Identifier: MIT
#

BBPATH .= ":${LAYERDIR}"

BBFILES += "${LAYERDIR}/recipes-*/*/*.bb \
        ${LAYERDIR}/recipes-*/*/*.bbappend"

BBFILE_COLLECTIONS += "meta-srg-im8p"
BBFILE_PATTERN_meta-srg-im8p = "^${LAYERDIR}/recipes-"
BBFILE_PRIORITY_meta-srg-im8p = "36"

LAYERSERIES_COMPAT_meta-srg-im8p = "dunfell gatesgarth"

LAYERDIR_meta-srg-im8p = "${LAYERDIR}"
```

## conf/machine/srg-im8p.conf
```bitbake
#@TYPE: Machine
#@NAME: AAEON SRG-IM8P Gateway
#@SOC: i.MX8MP
#@DESCRIPTION: Machine configuration for AAEON SRG-IM8P Gateway
#@MAINTAINER: KunYi Chen <kunyi.chen@gmail.com>
#@SPDX-License-Identifier: MIT

MACHINEOVERRIDES =. "mx8:mx8m:mx8mp:"

require conf/machine/include/imx-base.inc
require conf/machine/include/tune-cortexa53.inc

# for arm64 booting requirement
UBOOT_ENTRYPOINT_mx8mp  = "0x40480000"
KERNEL_LOADADDR_mx8mp = "0x40480000"

MACHINE_FEATURES += " pci optee tpm2"

#KERNEL_IMAGETYPES_append += "fitImage"
#KERNEL_CLASSES += "kernel-fitimage"

KERNEL_DEVICETREE = " \
                     freescale/srg-im8p.dtb \
"
# Add DTB of i.MX 8MP LPDDR4 EVK
KERNEL_DEVICETREE += " \
                     freescale/imx8mp-evk.dtb \
"

WKS_FILE_DEPENDS_append = " imx-m7-demos"
IMAGE_BOOT_FILES += "imx8mp_m7_TCM_hello_world.bin \
                    imx8mp_m7_TCM_rpmsg_lite_pingpong_rtos_linux_remote.bin \
                    imx8mp_m7_TCM_rpmsg_lite_str_echo_rtos.bin \
                    imx8mp_m7_TCM_sai_low_power_audio.bin \
"

UBOOT_CONFIG ??= "sd"
UBOOT_CONFIG[sd] = "srg-im8p_defconfig,sdcard"
UBOOT_CONFIG[fspi] = "srg-im8p_defconfig"
UBOOT_CONFIG[mfgtool] = "srg-im8p_defconfig"
SPL_BINARY = "spl/u-boot-spl.bin"

# U-Boot configuration
PREFERRED_PROVIDER_u-boot = "u-boot-aaeon"
IMX_DEFAULT_BOOTLOADER_mx8mp = "u-boot-aaeon"
PREFERRED_PROVIDER_virtual/bootloader_mx8 = "u-boot-aaeon"
#PREFERRED_PROVIDER_imx-atf ??= "imx-atf"
SPL_BINARY = "spl/u-boot-spl.bin"
# Set u-boot DTB
UBOOT_DTB_NAME = "srg-im8p.dtb"
UBOOT_MAKE_TARGET = ""
UBOOT_SUFFIX = "bin"

# Set DDR FIRMWARE
DDR_FIRMWARE_NAME = "lpddr4_pmu_train_1d_dmem_202006.bin lpddr4_pmu_train_1d_imem_202006.bin lpddr4_pmu_train_2d_dmem_202006.bin lpddr4_pmu_train_2d_imem_202006.bin"

# Set imx-mkimage boot target
IMXBOOT_TARGETS = "${@bb.utils.contains('UBOOT_CONFIG', 'fspi', 'flash_evk_flexspi', 'flash_evk', d)}"

# Set Serial console
SERIAL_CONSOLES = "115200;ttymxc1"

IMAGE_BOOTLOADER = "imx-boot"

LOADADDR = ""
UBOOT_SUFFIX = "bin"
UBOOT_MAKE_TARGET = ""
IMX_BOOT_SEEK = "32"

OPTEE_BIN_EXT = "8mp"

PREFERRED_PROVIDER_virtual/kernel = "linux-imx"

SOC_DEFAULT_WKS_FILE_mx8mp = "srg-im8p-image.wks.in"
```

## recipes-support/swupdate/swupdate/defconfig
```kconfig
CONFIG_HAVE_DOT_CONFIG=y

#
# General Configuration
#
# CONFIG_MTD is not set
# CONFIG_CURL is not set
# CONFIG_CURL_SSL is not set
CONFIG_SYSTEMD=y
CONFIG_DEFAULT_CONFIG_FILE="/etc/swupdate/swupdate.cfg"
CONFIG_SCRIPTS=y
CONFIG_HW_COMPATIBILITY=y
CONFIG_HW_COMPATIBILITY_FILE="/etc/swupdate-hw-compat"
CONFIG_SW_VERSIONS_FILE="/etc/sw-versions"

#
# Socket Paths
#
CONFIG_LUA=y
CONFIG_LUAPKG="lua"
# CONFIG_FEATURE_SYSLOG is not set

#
# Build Options
#
CONFIG_CROSS_COMPILE=""
CONFIG_SYSROOT=""
CONFIG_EXTRA_CFLAGS=""
CONFIG_EXTRA_LDFLAGS=""
CONFIG_EXTRA_LDLIBS=""

CONFIG_UBOOT=y
CONFIG_UBOOT_NEWAPI=y
CONFIG_UBOOT_FWENV="/etc/fw_env.config"
CONFIG_HASH_VERIFY=y
CONFIG_SIGNED_IMAGES=y
CONFIG_SIGALG_RAWRSA=y

CONFIG_GUNZIP=y
CONFIG_ZSTD=y

# for hawkbit
CONFIG_SURICATTA=y

#
# embedded web server
#
# CONFIG_WEBSERVER is not set
# CONFIG_MONGOOSESSL is not set

#
#Parser Features
#
CONFIG_LIBCONFIG=y
CONFIG_PARSERROOT=""

#
# Image Handler
#
CONFIG_RAW=y
CONFIG_ARCHIVE=y
CONFIG_RDIFFHANDLER=y
CONFIG_BOOTLOADERHANDLER=y
CONFIG_RDIFFHANDLER=y
CONFIG_LUASCRIPTHANDLER=y
CONFIG_SHELLSCRIPTHANDLER=y
CONFIG_HANDLER_IN_LUA=y
CONFIG_REMOTE_HANDLER=y
```
